// These arguments were used when this file was generated. They will be automatically applied on subsequent loads 
// via the GUI or CLI invocations. Run CLI with '--help' for additional information on how to override these arguments.
// @cliArgs --board "/ti/boards/CC3220SF_LAUNCHXL" --product "simplelink_cc32xx_sdk@3.30.01.02"
// @versions {"data":"2019103101","timestamp":"2019103101","tool":"1.3.1030","templates":"2019103101"}

var SimpleLinkWifi = scripting.addModule("/ti/drivers/net/wifi/SimpleLinkWifi");
var Crypto = scripting.addModule("/ti/drivers/Crypto");
var Crypto1 = Crypto.addInstance();
var Power = scripting.addModule("/ti/drivers/Power");
var Board = scripting.addModule("/ti/drivers/Board");
var DriverLib = scripting.addModule("/ti/devices/DriverLib");
var Display = scripting.addModule("/ti/display/Display");
var Display1 = Display.addInstance();
var UART = scripting.addModule("/ti/drivers/UART", {}, false);
var DMA = scripting.addModule("/ti/drivers/DMA");
var GPIO = scripting.addModule("/ti/drivers/GPIO");
var GPIO1 = GPIO.addInstance();
var GPIO2 = GPIO.addInstance();
var GPIO3 = GPIO.addInstance();
var SPI = scripting.addModule("/ti/drivers/SPI");
var SPI1 = SPI.addInstance();
var Watchdog = scripting.addModule("/ti/drivers/Watchdog");
var Watchdog1 = Watchdog.addInstance();
var UART1 = UART.addInstance();
var GPIO4 = GPIO.addInstance();
var GPIO5 = GPIO.addInstance();
var GPIO6 = GPIO.addInstance();
var GPIO7 = GPIO.addInstance();
var GPIO8 = GPIO.addInstance();
var LED = scripting.addModule("/ti/drivers/apps/LED", {}, false);
var LED1 = LED.addInstance();
var LED2 = LED.addInstance();
// Name - The C/C++ identifier used in applications as the index parameter passed to Crypto runtime APIs
Crypto1.$name = "CONFIG_Crypto_0";
// IO Retention Shutdown - IO groups to be retained during Shutdown
Power.ioRetentionShutdown = ["GRP_1"];
// Name
Power.parkPins.$name = "ti_drivers_power_PowerCC32XXPins0";
// Name - The C/C++ identifier used in applications as the index parameter passed to Display runtime APIs
Display1.$name = "CONFIG_Display_0";
// Use Hardware - Select the hardware to use, or 'None' to use available header pins
Display1.$hardware = system.deviceData.board.components.XDS110UART;
// Name - The C/C++ identifier used in applications as the index parameter passed to UART runtime APIs
Display1.uart.$name = "CONFIG_UART_0";
// Name
Display1.uart.uart.$name = "MyUART1";
// Name - The C/C++ identifier used in applications as the index parameter passed to GPIO runtime APIs
GPIO1.$name = "CONFIG_GPIO_0";
// Mode - Select the GPIO mode
GPIO1.mode = "Dynamic";
// Assign pin
GPIO1.gpioPin.$assign = "boosterpack.19"; // P18
// Name - The C/C++ identifier used in applications as the index parameter passed to GPIO runtime APIs
GPIO2.$name = "CONFIG_GPIO_1";
// Mode - Select the GPIO mode
GPIO2.mode = "Dynamic";
// Assign pin
GPIO2.gpioPin.$assign = "boosterpack.2"; // P58*
// Name - The C/C++ identifier used in applications as the index parameter passed to GPIO runtime APIs
GPIO3.$name = "CONFIG_GPIO_2";
// Mode - Select the GPIO mode
GPIO3.mode = "Dynamic";
// Assign pin
GPIO3.gpioPin.$assign = "boosterpack.4"; // P03
// Name - The C/C++ identifier used in applications as the index parameter passed to SPI runtime APIs
SPI1.$name = "CONFIG_SPI_0";
// Mode - In three pin mode the SS signal is not used.
SPI1.mode = "Four Pin SS Active Low";
// Default TX Buffer Value - Specifies the default transmit buffer value.
SPI1.defaultTxBufferValue = "0";
// Name
SPI1.spi.$name = "MySPI1";
// Use Peripheral
SPI1.spi.$assign = "SPI0";
// Assign pin
SPI1.spi.sclkPin.$assign = "boosterpack.7"; // P05
// Assign pin
SPI1.spi.misoPin.$assign = "boosterpack.14"; // P06
// Assign pin
SPI1.spi.mosiPin.$assign = "boosterpack.15"; // P07
// Assign pin
SPI1.spi.ssPin.$assign = "boosterpack.18"; // P08
// Assign pin
SPI1.spi.dmaRxChannel.$assign = "UDMA_CH6";
// Assign pin
SPI1.spi.dmaTxChannel.$assign = "UDMA_CH7";
// Name - The C/C++ identifier used in applications as the index parameter passed to Watchdog runtime APIs
Watchdog1.$name = "CONFIG_WATCHDOG_0";
// Name
Watchdog1.watchdog.$name = "MyWATCHDOG1";
// Use Peripheral
Watchdog1.watchdog.$assign = "WATCHDOG0";
// Name - The C/C++ identifier used in applications as the index parameter passed to UART runtime APIs
UART1.$name = "CONFIG_UART_1";
// Data Direction
UART1.dataDirection = "Send Only";
// Name
UART1.uart.$name = "MyUART1";
// Name - The C/C++ identifier used in applications as the index parameter passed to GPIO runtime APIs
GPIO4.$name = "CONFIG_GPIO_3";
// Name - The C/C++ identifier used in applications as the index parameter passed to GPIO runtime APIs
GPIO5.$name = "CONFIG_GPIO_4";
// Name - The C/C++ identifier used in applications as the index parameter passed to GPIO runtime APIs
GPIO6.$name = "CONFIG_GPIO_5";
// Name - The C/C++ identifier used in applications as the index parameter passed to GPIO runtime APIs
GPIO7.$name = "CONFIG_GPIO_6";
// Name - The C/C++ identifier used in applications as the index parameter passed to GPIO runtime APIs
GPIO8.$name = "CONFIG_GPIO_7";
// Name - The C/C++ identifier used in applications as the index parameter passed to LED runtime APIs
LED1.$name = "CONFIG_LED_0";
// Name - The C/C++ identifier used in applications as the index parameter passed to LED runtime APIs
LED2.$name = "CONFIG_LED_1";
// Suggest solution
Display1.uart.uart.$suggestSolution = "UART1";
// Suggest solution
Display1.uart.uart.txPin.$suggestSolution = "55";
// Suggest solution
Display1.uart.uart.rxPin.$suggestSolution = "57";
// Suggest solution
UART1.uart.$suggestSolution = "UART0";
// Suggest solution
UART1.uart.txPin.$suggestSolution = "62";
// Suggest solution
GPIO4.gpioPin.$suggestSolution = "21";
// Suggest solution
GPIO5.gpioPin.$suggestSolution = "45";
// Suggest solution
GPIO6.gpioPin.$suggestSolution = "50";
// Suggest solution
GPIO7.gpioPin.$suggestSolution = "53";
// Suggest solution
GPIO8.gpioPin.$suggestSolution = "59";
// Suggest solution
LED1.gpioPin.gpioPin.$suggestSolution = "60";
// Suggest solution
LED2.gpioPin.gpioPin.$suggestSolution = "61";
