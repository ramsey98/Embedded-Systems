// These arguments were used when this file was generated. They will be automatically applied on subsequent loads 
// via the GUI or CLI invocations. Run CLI with '--help' for additional information on how to override these arguments.
// @cliArgs --board "/ti/boards/CC3220SF_LAUNCHXL" --product "simplelink_cc32xx_sdk@3.30.01.02"
// @versions {"data":"2019103101","timestamp":"2019103101","tool":"1.3.1030","templates":"2019103101"}

var RTOS = scripting.addModule("/ti/drivers/RTOS");
var Timer = scripting.addModule("/ti/drivers/Timer");
var Timer1 = Timer.addInstance();
var GPIO = scripting.addModule("/ti/drivers/GPIO", {}, false);
var GPIO1 = GPIO.addInstance();
var GPIO2 = GPIO.addInstance();
var GPIO3 = GPIO.addInstance();
var GPIO4 = GPIO.addInstance();
var GPIO5 = GPIO.addInstance();
var GPIO6 = GPIO.addInstance();
var GPIO7 = GPIO.addInstance();
var GPIO8 = GPIO.addInstance();
var UART = scripting.addModule("/ti/drivers/UART", {}, false);
var UART1 = UART.addInstance();
// name - Select the RTOS being used
RTOS.name = "FreeRTOS";
// Name - The C/C++ identifier used in applications as the index parameter passed to Timer runtime APIs
Timer1.$name = "CONFIG_TIMER_0";
// Timer Type
Timer1.timerType = "32 Bits";
var Power = scripting.addModule("/ti/drivers/Power", {}, false);
// Name
Power.parkPins.$name = "ti_drivers_power_PowerCC32XXPins0";
var Board = scripting.addModule("/ti/drivers/Board", {}, false);
var DriverLib = scripting.addModule("/ti/devices/DriverLib", {}, false);
// Name
Timer1.timer.$name = "MyTimer1";
// Name - The C/C++ identifier used in applications as the index parameter passed to GPIO runtime APIs
GPIO1.$name = "CONFIG_GPIO_0";
// Mode - Select the GPIO mode
GPIO1.mode = "Output";
// Name - The C/C++ identifier used in applications as the index parameter passed to GPIO runtime APIs
GPIO2.$name = "CONFIG_GPIO_1";
// Mode - Select the GPIO mode
GPIO2.mode = "Output";
// Name - The C/C++ identifier used in applications as the index parameter passed to GPIO runtime APIs
GPIO3.$name = "CONFIG_GPIO_2";
// Mode - Select the GPIO mode
GPIO3.mode = "Output";
// Name - The C/C++ identifier used in applications as the index parameter passed to GPIO runtime APIs
GPIO4.$name = "CONFIG_GPIO_3";
// Mode - Select the GPIO mode
GPIO4.mode = "Output";
// Name - The C/C++ identifier used in applications as the index parameter passed to GPIO runtime APIs
GPIO5.$name = "CONFIG_GPIO_4";
// Mode - Select the GPIO mode
GPIO5.mode = "Output";
// Name - The C/C++ identifier used in applications as the index parameter passed to GPIO runtime APIs
GPIO6.$name = "CONFIG_GPIO_5";
// Mode - Select the GPIO mode
GPIO6.mode = "Output";
// Name - The C/C++ identifier used in applications as the index parameter passed to GPIO runtime APIs
GPIO7.$name = "CONFIG_GPIO_6";
// Mode - Select the GPIO mode
GPIO7.mode = "Output";
// Name - The C/C++ identifier used in applications as the index parameter passed to GPIO runtime APIs
GPIO8.$name = "CONFIG_GPIO_7";
// Mode - Select the GPIO mode
GPIO8.mode = "Output";
// Name - The C/C++ identifier used in applications as the index parameter passed to UART runtime APIs
UART1.$name = "CONFIG_UART_0";
// Use Hardware - Select the hardware to use, or 'None' to use available header pins
UART1.$hardware = system.deviceData.board.components.XDS110UART;
// Name
UART1.uart.$name = "MyUART1";
// Suggest solution
Timer1.timer.$suggestSolution = "Timer1";
// Suggest solution
GPIO1.gpioPin.$suggestSolution = "3";
// Suggest solution
GPIO2.gpioPin.$suggestSolution = "5";
// Suggest solution
GPIO3.gpioPin.$suggestSolution = "6";
// Suggest solution
GPIO4.gpioPin.$suggestSolution = "7";
// Suggest solution
GPIO5.gpioPin.$suggestSolution = "8";
// Suggest solution
GPIO6.gpioPin.$suggestSolution = "18";
// Suggest solution
GPIO7.gpioPin.$suggestSolution = "21";
// Suggest solution
GPIO8.gpioPin.$suggestSolution = "45";
// Suggest solution
UART1.uart.$suggestSolution = "UART0";
// Suggest solution
UART1.uart.txPin.$suggestSolution = "55";
// Suggest solution
UART1.uart.rxPin.$suggestSolution = "57";
