// These arguments were used when this file was generated. They will be automatically applied on subsequent loads 
// via the GUI or CLI invocations. Run CLI with '--help' for additional information on how to override these arguments.
// @cliArgs --board "/ti/boards/CC3220SF_LAUNCHXL" --product "simplelink_cc32xx_sdk@3.30.01.02"
// @versions {"data":"2019103101","timestamp":"2019103101","tool":"1.3.1030","templates":"2019103101"}

var RTOS = scripting.addModule("/ti/drivers/RTOS");
var Timer = scripting.addModule("/ti/drivers/Timer");
var Timer1 = Timer.addInstance();
var GPIO = scripting.addModule("/ti/drivers/GPIO", {}, false);
var GPIO1 = GPIO.addInstance();
var GPIO2 = GPIO.addInstance();
var GPIO3 = GPIO.addInstance();
var GPIO4 = GPIO.addInstance();
var GPIO5 = GPIO.addInstance();
var GPIO6 = GPIO.addInstance();
var GPIO7 = GPIO.addInstance();
var GPIO8 = GPIO.addInstance();
var UART = scripting.addModule("/ti/drivers/UART", {}, false);
var UART1 = UART.addInstance();
var LED = scripting.addModule("/ti/drivers/apps/LED", {}, false);
var LED1 = LED.addInstance();
var Timer2 = Timer.addInstance();
var SPI = scripting.addModule("/ti/drivers/SPI");
var SPI1 = SPI.addInstance();
var Capture = scripting.addModule("/ti/drivers/Capture", {}, false);
var Capture1 = Capture.addInstance();
var GPIO10 = GPIO.addInstance();
// name - Select the RTOS being used
RTOS.name = "FreeRTOS";
// Name - The C/C++ identifier used in applications as the index parameter passed to Timer runtime APIs
Timer1.$name = "CONFIG_TIMER_0";
// Timer Type
Timer1.timerType = "32 Bits";
var Power = scripting.addModule("/ti/drivers/Power", {}, false);
// Name
Power.parkPins.$name = "ti_drivers_power_PowerCC32XXPins0";
var Board = scripting.addModule("/ti/drivers/Board", {}, false);
var DriverLib = scripting.addModule("/ti/devices/DriverLib", {}, false);
// Name
Timer1.timer.$name = "MyTimer1";
// Name - The C/C++ identifier used in applications as the index parameter passed to GPIO runtime APIs
GPIO1.$name = "CONFIG_GPIO_0";
// Mode - Select the GPIO mode
GPIO1.mode = "Output";
// Name - The C/C++ identifier used in applications as the index parameter passed to GPIO runtime APIs
GPIO2.$name = "CONFIG_GPIO_1";
// Mode - Select the GPIO mode
GPIO2.mode = "Output";
// Name - The C/C++ identifier used in applications as the index parameter passed to GPIO runtime APIs
GPIO3.$name = "CONFIG_GPIO_2";
// Mode - Select the GPIO mode
GPIO3.mode = "Output";
// Name - The C/C++ identifier used in applications as the index parameter passed to GPIO runtime APIs
GPIO4.$name = "CONFIG_GPIO_3";
// Mode - Select the GPIO mode
GPIO4.mode = "Output";
// Assign pin
GPIO4.gpioPin.$assign = "boosterpack.27"; // P63
// Name - The C/C++ identifier used in applications as the index parameter passed to GPIO runtime APIs
GPIO5.$name = "CONFIG_GPIO_4";
// Mode - Select the GPIO mode
GPIO5.mode = "Output";
// Assign pin
GPIO5.gpioPin.$assign = "boosterpack.28"; // P53
// Name - The C/C++ identifier used in applications as the index parameter passed to GPIO runtime APIs
GPIO6.$name = "CONFIG_GPIO_5";
// Mode - Select the GPIO mode
GPIO6.mode = "Output";
// Assign pin
GPIO6.gpioPin.$assign = "boosterpack.2"; // P58*
// Name - The C/C++ identifier used in applications as the index parameter passed to GPIO runtime APIs
GPIO7.$name = "CONFIG_GPIO_6";
// Mode - Select the GPIO mode
GPIO7.mode = "Output";
// Assign pin
GPIO7.gpioPin.$assign = "boosterpack.26"; // P59
// Name - The C/C++ identifier used in applications as the index parameter passed to GPIO runtime APIs
GPIO8.$name = "CONFIG_GPIO_7";
// Mode - Select the GPIO mode
GPIO8.mode = "Output";
// Assign pin
GPIO8.gpioPin.$assign = "boosterpack.24"; // P60
// Name - The C/C++ identifier used in applications as the index parameter passed to UART runtime APIs
UART1.$name = "CONFIG_UART_0";
// Use Hardware - Select the hardware to use, or 'None' to use available header pins
UART1.$hardware = system.deviceData.board.components.XDS110UART;
// Data Direction
UART1.dataDirection = "Send Only";
// Name
UART1.uart.$name = "MyUART1";
// Name - The C/C++ identifier used in applications as the index parameter passed to LED runtime APIs
LED1.$name = "CONFIG_LED_0";
// Use Hardware - Select the hardware to use, or 'None' to use available header pins
LED1.gpioPin.$hardware = system.deviceData.board.components.LED_RED;
// Name - The C/C++ identifier used in applications as the index parameter passed to Timer runtime APIs
Timer2.$name = "CONFIG_TIMER_1";
// Name
Timer2.timer.$name = "MyTimer1";
var DMA = scripting.addModule("/ti/drivers/DMA", {}, false);
// Name - The C/C++ identifier used in applications as the index parameter passed to SPI runtime APIs
SPI1.$name = "CONFIG_SPI_0";
// Mode - In three pin mode the SS signal is not used.
SPI1.mode = "Four Pin SS Active Low";
// Name
SPI1.spi.$name = "MySPI1";
// Name - The C/C++ identifier used in applications as the index parameter passed to Capture runtime APIs
Capture1.$name = "CONFIG_CAPTURE_0";
// Name
Capture1.timer.$name = "MyTimer1";
// Name - The C/C++ identifier used in applications as the index parameter passed to GPIO runtime APIs
GPIO10.$name = "CONFIG_GPIO_8";
// Mode - Select the GPIO mode
GPIO10.mode = "Output";
// Assign pin
GPIO10.gpioPin.$assign = "boosterpack.30"; // P50
// Suggest solution
Timer1.timer.$suggestSolution = "Timer2";
// Suggest solution
GPIO1.gpioPin.$suggestSolution = "18";
// Suggest solution
GPIO2.gpioPin.$suggestSolution = "21";
// Suggest solution
GPIO3.gpioPin.$suggestSolution = "45";
// Suggest solution
UART1.uart.$suggestSolution = "UART0";
// Suggest solution
UART1.uart.txPin.$suggestSolution = "55";
// Suggest solution
LED1.gpioPin.gpioPin.$suggestSolution = "64";
// Suggest solution
Timer2.timer.$suggestSolution = "Timer0";
// Suggest solution
SPI1.spi.$suggestSolution = "SPI0";
// Suggest solution
SPI1.spi.sclkPin.$suggestSolution = "5";
// Suggest solution
SPI1.spi.misoPin.$suggestSolution = "6";
// Suggest solution
SPI1.spi.mosiPin.$suggestSolution = "7";
// Suggest solution
SPI1.spi.ssPin.$suggestSolution = "8";
// Suggest solution
SPI1.spi.dmaRxChannel.$suggestSolution = "UDMA_CH30";
// Suggest solution
SPI1.spi.dmaTxChannel.$suggestSolution = "UDMA_CH31";
// Suggest solution
Capture1.timer.$suggestSolution = "Timer1";
// Suggest solution
Capture1.timer.capturePin.$suggestSolution = "3";
